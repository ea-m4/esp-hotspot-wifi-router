## sdkconfig.defaults
```kconfig
# Required for WiFi bridge / NAPT
CONFIG_LWIP_IP_FORWARD=y
CONFIG_LWIP_IPV4_NAPT=y

# Larger TCP windows significantly improve throughput when bridging
# Default is ~5 KB; 64 KB matches modern OS TCP behaviour
CONFIG_LWIP_TCP_SND_BUF_DEFAULT=65535
CONFIG_LWIP_TCP_WND_DEFAULT=65535
CONFIG_LWIP_TCP_RECVMBOX_SIZE=12
CONFIG_LWIP_UDP_RECVMBOX_SIZE=12

# Extra WiFi RX buffers to absorb traffic bursts from both STA and AP
CONFIG_ESP_WIFI_STATIC_RX_BUFFER_NUM=16
CONFIG_ESP_WIFI_DYNAMIC_RX_BUFFER_NUM=32
```
